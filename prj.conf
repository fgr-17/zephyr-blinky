## CMakeLists.txt
```
# SPDX-License-Identifier: Apache-2.0

cmake_minimum_required(VERSION 3.20.0)
find_package(Zephyr REQUIRED HINTS $ENV{ZEPHYR_BASE})
project(blinky)

# set(CMAKE_CXX_STANDARD_LIBRARIES "-lc++ -lc -lm -lgcc -lnosys")

set(SRC_DIR "src")

set(INLCUDE_DIRS
    "${SRC_DIR}/common"
    "${SRC_DIR}/bsp"
    "${SRC_DIR}/led"
    "${SRC_DIR}/task"
)

set(SRC_FILES
    "${SRC_DIR}/main.cpp"
    "${SRC_DIR}/led/led.cpp"
    "${SRC_DIR}/task/led_array.cpp"
    "${SRC_DIR}/common/print.cpp"
    "${SRC_DIR}/bsp/instances.cpp"
    "${SRC_DIR}/bsp/dt_instances.cpp"
)

target_include_directories(app PRIVATE ${INLCUDE_DIRS})
target_sources(app PRIVATE ${SRC_FILES})
```

## prj.conf
```kconfig
CONFIG_GPIO=y
CONFIG_CPP=y
CONFIG_CPP_MAIN=y
CONFIG_COMMON_LIBC_MALLOC_ARENA_SIZE=128
CONFIG_LIB_CPLUSPLUS=y
```

## boards/nrf52840dk_nrf52840.overlay
```dts
/ {
    aliases {
        l0 = &led0;
        l1 = &led1;
        l2 = &led2;
        l3 = &led3;
    };
};
```

## boards/nucleo_u575zi_q.overlay
```dts
/ {
    aliases {
        l0 = &green_led_1;
        l1 = &blue_led_1;
        l2 = &red_led_1;
        board_model = &model;
    };
};
```

## boards/rpi_pico.overlay
```dts
/ {
    aliases {
        l0 = &led0;
    };
};
```

## src/main.c
```c
/*
 * Copyright (c) 2016 Intel Corporation
 *
 * SPDX-License-Identifier: Apache-2.0
 */

#include <zephyr/kernel.h>
#include <zephyr/drivers/gpio.h>

/* 1000 msec = 1 sec */
#define SLEEP_TIME_MS  500

/* The devicetree node identifier for the "led0" alias. */
// #define LED0_NODE DT_ALIAS(led0)
// #define LED1_NODE DT_ALIAS(led1)


/* Get node directly without aliases */
#define LED1_NODE DT_NODELABEL(green_led_1)
#define LED2_NODE DT_NODELABEL(blue_led_1)
#define LED3_NODE DT_NODELABEL(red_led_1)


/*
 * A build error on this line means your board is unsupported.
 * See the sample documentation for information on how to fix this.
 */

static const struct gpio_dt_spec led_green = GPIO_DT_SPEC_GET(LED1_NODE, gpios);
static const struct gpio_dt_spec led_blue = GPIO_DT_SPEC_GET(LED2_NODE, gpios);
static const struct gpio_dt_spec led_red = GPIO_DT_SPEC_GET(LED3_NODE, gpios);


typedef enum {LED_GREEN, LED_BLUE, LED_RED} leds_t;

int main(void)
{
	leds_t led_active = LED_GREEN;

	if (!gpio_is_ready_dt(&led_green)) {
		return 0;
	}

	if (!gpio_is_ready_dt(&led_blue)) {
		return 0;
	}

	if (!gpio_is_ready_dt(&led_red)) {
		return 0;
	}

	if (gpio_pin_configure_dt(&led_green, GPIO_OUTPUT_ACTIVE) < 0) {
		return 0;
	}

	if (gpio_pin_configure_dt(&led_blue, GPIO_OUTPUT_ACTIVE) < 0) {
		return 0;
	}

	if (gpio_pin_configure_dt(&led_red, GPIO_OUTPUT_ACTIVE) < 0) {
		return 0;
	}


	if (gpio_pin_set_dt(&led_green, 1)) {
		return 0;
	}

	led_active = LED_BLUE;



	while (1) {


		switch(led_active) {

			case LED_GREEN: {
					if (gpio_pin_set_dt(&led_green, 1)) {
						return 0;
					}
					if (gpio_pin_set_dt(&led_blue, 0)) {
						return 0;
					}
					if (gpio_pin_set_dt(&led_red, 0)) {
						return 0;
					}
					led_active = LED_BLUE;
				}
				break;
			case LED_BLUE: {
					if (gpio_pin_set_dt(&led_green, 0)) {
						return 0;
					}
					if (gpio_pin_set_dt(&led_blue, 1)) {
						return 0;
					}
					if (gpio_pin_set_dt(&led_red, 0)) {
						return 0;
					}
					led_active = LED_RED;
				}
				break;
			case LED_RED: {
					if (gpio_pin_set_dt(&led_green, 0)) {
						return 0;
					}
					if (gpio_pin_set_dt(&led_blue, 0)) {
						return 0;
					}
					if (gpio_pin_set_dt(&led_red, 1)) {
						return 0;
					}
					led_active = LED_GREEN;
					}
				break;
			default: {
				
				}
				return 0;
		}

		k_msleep(SLEEP_TIME_MS);
	}
	return 0;
}
```

## src/main.cpp
```c
/*
 * Copyright (c) 2016 Intel Corporation
 *
 * SPDX-License-Identifier: Apache-2.0
 */


#include <zephyr/kernel.h>
#include <led_array.h>
#include <print.h>

#include <vector>

#include <instances.h>

#include "version_git_hash.h"
#include "version_git_branch.h"

#define SLEEP_TIME_MS  500

int main(void) {

	led_array leds(led_array::led_vector {{led0, 0, 1000, "led 0"}, 
										  {led1, 300, 1000, "led 1"},
										  {led2, 600, 1000, "led 2"},
										  {led3, 900, 1000, "led 3"}});

	printk("==================================================\n");
    print_info("Board: " CONFIG_BOARD);
	print_info("Git Info:" BLINKY_GIT_HASH "@" BLINKY_GIT_BRANCH);
	printk("==================================================\n");

	leds.init();

	while (1) {
		k_msleep(SLEEP_TIME_MS);
	}
	return 0;
}
```
